// SPDX-License-Identifier: GPL-2.0-only
// Definitions for IMX477 camera module on VC I2C bus
/dts-v1/;
/plugin/;

#include "imx477_378-overlay.dtsi"

&cam_node {
	compatible = "sony,imx477";
};

/ {
	/* Dormant: link the sensor to the lens controller (dtparam cef168) */
	fragment@98 {
		target = <&cam_node>;
		__dormant__ {
			lens-focus = <&vcm_node>;
		};
	};
};

/{
	__overrides__ {
		cef168 = <&vcm_node>,"status",
			 <0>,"=98";
		sync-sink = <&cam_node>,"trigger-mode:0=2";
		sync-source = <&cam_node>,"trigger-mode:0=1";
	};
};
